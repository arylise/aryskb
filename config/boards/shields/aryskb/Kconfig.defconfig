## config/boards/shields/aryskb/Kconfig.defconfig
```kconfig
# Copyright (c) 2021 The ZMK Contributors
# SPDX-License-Identifier: MIT

if SHIELD_ARYSKB

config ZMK_KEYBOARD_NAME
    default "ArysKB"

endif
```
